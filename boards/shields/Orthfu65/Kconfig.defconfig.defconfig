## boards/shields/Orthfu65/Kconfig.defconfig.defconfig
```kconfig
# Copyright (c) 2022 The ZMK Contributors
# SPDX-License-Identifier: MIT

if SHIELD_ORTHFU65

config ZMK_KEYBOARD_NAME
    default "Orthfu65"

endif
```
